## libs/Kconfig
```kconfig
menu "Librairies Menu"

    config LIB_FRAME_STREAMER
        bool "Frame streamer"
        default n

    config LIB_OPENMP
        bool "OpenMP"
        default n

    source "$(GAP_SDK_HOME)/libs/gap_lib/Kconfig"

endmenu
```

## libs/gap_lib/Kconfig
```kconfig
# Copyright (c) 2022 GreenWaves Technologies SAS
# All rights reserved.
#
# Redistribution and use in source and binary forms, with or without
# modification, are permitted provided that the following conditions are met:
#
# 1. Redistributions of source code must retain the above copyright notice,
#    this list of conditions and the following disclaimer.
# 2. Redistributions in binary form must reproduce the above copyright
#    notice, this list of conditions and the following disclaimer in the
#    documentation and/or other materials provided with the distribution.
# 3. Neither the name of GreenWaves Technologies SAS nor the names of its
#    contributors may be used to endorse or promote products derived from
#    this software without specific prior written permission.
#
# THIS SOFTWARE IS PROVIDED BY THE COPYRIGHT HOLDERS AND CONTRIBUTORS "AS IS"
# AND ANY EXPRESS OR IMPLIED WARRANTIES, INCLUDING, BUT NOT LIMITED TO, THE
# IMPLIED WARRANTIES OF MERCHANTABILITY AND FITNESS FOR A PARTICULAR PURPOSE
# ARE DISCLAIMED. IN NO EVENT SHALL THE COPYRIGHT OWNER OR CONTRIBUTORS BE
# LIABLE FOR ANY DIRECT, INDIRECT, INCIDENTAL, SPECIAL, EXEMPLARY, OR
# CONSEQUENTIAL DAMAGES (INCLUDING, BUT NOT LIMITED TO, PROCUREMENT OF
# SUBSTITUTE GOODS OR SERVICES; LOSS OF USE, DATA, OR PROFITS; OR BUSINESS
# INTERRUPTION) HOWEVER CAUSED AND ON ANY THEORY OF LIABILITY, WHETHER IN
# CONTRACT, STRICT LIABILITY, OR TORT (INCLUDING NEGLIGENCE OR OTHERWISE)
# ARISING IN ANY WAY OUT OF THE USE OF THIS SOFTWARE, EVEN IF ADVISED OF THE
# POSSIBILITY OF SUCH DAMAGE.

comment "GAP LIB Menu"

    # G722 Encoder Decoder ----------------------
    config GAP_LIB_G722_ENC_DEC
        bool "G722 encoder decoder"
        default n

    config GAP_LIB_G722_ENC_DEC_RUN_ON_FC
        bool "Run on FC"
        default n
        depends on GAP_LIB_G722_ENC_DEC

    # imgIO -------------------------------------
    config GAP_LIB_IMG_IO
        bool "IMG IO"
        default n

    config GAP_LIB_IMG_IO_EMUL
        bool "EMUL"
        default n
        depends on GAP_LIB_IMG_IO

    # jpeg --------------------------------------
    config GAP_LIB_JPEG
        bool "JPEG"
        default n
        select PMSIS_RTOS_CL_L1_MALLOC

    choice GAP_LIB_JPEG_QUALITY
        prompt "JPEG quality"
        depends on GAP_LIB_JPEG

        config QUALITY_50
            bool "Quality 50"

        config QUALITY_100
            bool "Quality 100"

        config QUALITY_95
            bool "Quality 95"

        config QUALITY_90
            bool "Quality 90"

        config QUALITY_20
            bool "Quality 20"

        config QUALITY_10
            bool "Quality 10"

        config QUALITY_0
            bool "Quality 0"
    endchoice

    # testbench ---------------------------------
    config GAP_LIB_TESTBENCH
        bool "Testbench"
        default n

    # wavIO -------------------------------------
    config GAP_LIB_WAV_IO
        bool "WAV IO"
        default n

    config GAP_LIB_WAV_IO_EMUL
        bool "EMUL"
        default n
        depends on GAP_LIB_WAV_IO
```

## rtos/Kconfig
```kconfig
menu "RTOS Menu"
    choice PMSIS_OS
        prompt "OS Selection"
        config PMSIS_OS_FREERTOS
            bool "Freertos"
            help
                Select FreeRTOS as GAP SDK OS. Default value
        config PMSIS_OS_PULPOS
            bool "Pulpos"
            help
                Select Pulp OS as GAP SDK OS
    endchoice

    if PMSIS_OS_FREERTOS
        source "$(GAP_SDK_HOME)/rtos/freeRTOS/Kconfig"        
    endif

    if PMSIS_OS_PULPOS
        # TODO: Source PulpOS Kconfig here 
    endif

    menu "PMSIS Menu"
        source "$(GAP_SDK_HOME)/rtos/pmsis/Kconfig"
        source "$(GAP_SDK_HOME)/rtos/freeRTOS/vendors/gwt/gap9/pmsis/Kconfig"
        source "$(GAP_SDK_HOME)/rtos/freeRTOS/vendors/gwt/pmsis/rtos/Kconfig"
    endmenu

    source "$(GAP_SDK_HOME)/rtos/pmsis/bsp/Kconfig"

endmenu
```

## rtos/freeRTOS/vendors/gwt/pmsis/rtos/Kconfig
```kconfig
comment "PMSIS_RTOS Menu"
    config PMSIS_RTOS_CL_L1_MALLOC
        bool "L1 CLuster Malloc driver"
        default n

    config PMSIS_RTOS_MALLOC_EXTERNAL
        bool "External Malloc driver"
        default n    

    config PMSIS_RTOS_MEM_SLAB
        bool "Mem Slab driver"
        default n    
```

## rtos/pmsis/Kconfig
```kconfig
comment "PMSIS menu"
config PMSIS_IMPLEM_FFC
    bool "FFC"
    default n

config PMSIS_IMPLEM_I2C
    bool "I2C"
    default n

config PMSIS_IMPLEM_I3C
    bool "I3C"
    default n

config PMSIS_IMPLEM_I2S
    bool "I2S"
    default n

config PMSIS_IMPLEM_SPIM
    bool "SPIM"
    default n

menu "UDMA"
    config PMSIS_IMPLEM_UDMA_DATAMOVE
        bool "Micro DMA data movement"
        default n
        help
            UDMA DATAMOVE driver provides an interface to use UDMA DATAMOVE channel
    
    config PMSIS_IMPLEM_UDMA_TIMEOUT
        bool "Micro DMA timeout"
        default n

    config PMSIS_IMPLEM_UDMA_TIMESTAMP
        bool "Micro DMA timestamp"
        default n
endmenu
```

## rtos/pmsis/bsp/Kconfig
```kconfig
menu "BSP Menu"

    comment "Driver selection" 
        
    menu "Memory"
        source "$(GAP_SDK_HOME)/rtos/pmsis/bsp/eeprom/Kconfig"
        source "$(GAP_SDK_HOME)/rtos/pmsis/bsp/flash/Kconfig"
        source "$(GAP_SDK_HOME)/rtos/pmsis/bsp/ram/Kconfig"
    endmenu

    source "$(GAP_SDK_HOME)/rtos/pmsis/bsp/adc/Kconfig"
    source "$(GAP_SDK_HOME)/rtos/pmsis/bsp/audio/Kconfig"
    source "$(GAP_SDK_HOME)/rtos/pmsis/bsp/ble/Kconfig"
    source "$(GAP_SDK_HOME)/rtos/pmsis/bsp/bootloader/Kconfig"
    source "$(GAP_SDK_HOME)/rtos/pmsis/bsp/camera/Kconfig"
    source "$(GAP_SDK_HOME)/rtos/pmsis/bsp/crc/Kconfig"
    source "$(GAP_SDK_HOME)/rtos/pmsis/bsp/display/Kconfig"
    source "$(GAP_SDK_HOME)/rtos/pmsis/bsp/fs/Kconfig"
    source "$(GAP_SDK_HOME)/rtos/pmsis/bsp/gpio/Kconfig"
    source "$(GAP_SDK_HOME)/rtos/pmsis/bsp/ota/Kconfig"
    source "$(GAP_SDK_HOME)/rtos/pmsis/bsp/partition/Kconfig"
    source "$(GAP_SDK_HOME)/rtos/pmsis/bsp/transport/Kconfig"

endmenu
```

## rtos/pmsis/bsp/adc/Kconfig
```kconfig
menu "ADC"
    config BSP_DRIVER_ADC_ADS1014
        bool "ADS1014"
        default n
        select PMSIS_IMPLEM_I2C
endmenu
```

## rtos/pmsis/bsp/audio/Kconfig
```kconfig
menu "Audio"
    config BSP_DRIVER_AUDIO_ADC_TLV320
        bool "TLV320"
        default n
        depends on BOARD_GAP9_EVK_AUDIO_ADDON
        select PMSIS_IMPLEM_I2C
        select BSP_DRIVER_GPIO_FXL6408

    config BSP_DRIVER_AUDIO_DAC_AK4332
        bool "AK4332"
        default n
        select PMSIS_IMPLEM_I2C
endmenu
```

## rtos/pmsis/bsp/ble/Kconfig
```kconfig
menu "Bluetooth Low Energy"
    config BSP_DRIVER_BLE_NINA_B112
        bool "NINA B112"
        default n
        select PMSIS_GAP9_IMPLEM_GPIO
        select PMSIS_GAP9_IMPLEM_UDMA_UART

    config BSP_DRIVER_BLE_NINA_B312
        bool "NINA B312"
        default n
        select PMSIS_GAP9_IMPLEM_GPIO
        select PMSIS_GAP9_IMPLEM_UDMA_UART
endmenu
```

## rtos/pmsis/bsp/bootloader/Kconfig
```kconfig
config BSP_DRIVER_BOOTLOADER
    bool "Bootloader"
    default n
    select BSP_DRIVER_FLASH_PARTITION
    select BSP_DRIVER_PARTITION
    select BSP_DRIVER_CRC_MD5
    select BSP_DRIVER_FLASH
    select BSP_DRIVER_OTA
```

## rtos/pmsis/bsp/camera/Kconfig
```kconfig
menu "Camera"
    config BSP_DRIVER_CAMERA_EPEAS_CIS001
        bool "EPEAS CIS001"
        depends on CHIP_FAMILY_GAP8
        default n

    config BSP_DRIVER_CAMERA_GC0308
        bool "GC0308"
        default n
        select PMSIS_GAP9_IMPLEM_UDMA_CPI
        select PMSIS_IMPLEM_I2C
        select PMSIS_GAP9_IMPLEM_GPIO

    config BSP_DRIVER_CAMERA_HIMAX
        bool "HIMAX"
        default n
        select PMSIS_GAP9_IMPLEM_UDMA_CPI
        select PMSIS_IMPLEM_I2C

    config BSP_DRIVER_CAMERA_HM0360
        bool "HM0360"
        default n
        select PMSIS_GAP9_IMPLEM_UDMA_CPI
        select PMSIS_IMPLEM_I2C
        select PMSIS_GAP9_IMPLEM_GPIO
    
    config BSP_DRIVER_CAMERA_MT9V034
        bool "MT9V034"
        default n
        select PMSIS_GAP9_IMPLEM_UDMA_CPI
        select PMSIS_IMPLEM_I2C
        select PMSIS_GAP9_IMPLEM_GPIO

    config BSP_DRIVER_CAMERA_OV5640
        bool "OV5640"
        default n
        select PMSIS_GAP9_IMPLEM_UDMA_CPI
        select PMSIS_IMPLEM_I2C
        select PMSIS_GAP9_IMPLEM_GPIO

    config BSP_DRIVER_CAMERA_OV5647
        bool "OV5647"
        default n
        select PMSIS_GAP9_IMPLEM_UDMA_CPI
        select PMSIS_IMPLEM_I2C
        select PMSIS_GAP9_IMPLEM_GPIO

    config BSP_DRIVER_CAMERA_OV7670
        bool "OV7670"
        default n
        select PMSIS_GAP9_IMPLEM_UDMA_CPI
        select PMSIS_IMPLEM_I2C
        select PMSIS_GAP9_IMPLEM_GPIO

    config BSP_DRIVER_CAMERA_OV9281
        bool "OV9281"
        default n
        select PMSIS_GAP9_IMPLEM_UDMA_CPI
        select PMSIS_IMPLEM_I2C
        select PMSIS_GAP9_IMPLEM_GPIO

    config BSP_DRIVER_CAMERA_PIXART
        bool "PIXART"
        default n
        select PMSIS_GAP9_IMPLEM_UDMA_CPI
        select PMSIS_IMPLEM_SPIM
        select PMSIS_GAP9_IMPLEM_GPIO
        select PMSIS_GAP9_IMPLEM_PWM

    config BSP_DRIVER_CAMERA_THERMEYE
        bool "THERMEYE"
        default n
        select PMSIS_GAP9_IMPLEM_UDMA_CPI
        select PMSIS_IMPLEM_I2C
        select PMSIS_GAP9_IMPLEM_GPIO
        select PMSIS_GAP9_IMPLEM_PWM
        
endmenu
```

## rtos/pmsis/bsp/display/Kconfig
```kconfig
menu "Displays"

    config BSP_DRIVER_DISPLAY_ILI9341
        bool "ili9341"
        default n
        select PMSIS_GAP9_IMPLEM_GPIO
        select PMSIS_IMPLEM_SPIM

endmenu
```

## rtos/pmsis/bsp/eeprom/Kconfig
```kconfig
menu "EEPROM"
    config BSP_DRIVER_EEPROM_24XX1025
        bool "24XX1025"
        default n
        select PMSIS_IMPLEM_I2C

    config BSP_DRIVER_EEPROM_M24C02
        bool "M24C02"
        default n
        select PMSIS_IMPLEM_I2C


    config BSP_DRIVER_EEPROM_VIRTUAL
        bool "Virtual EEPROM"
        default n
        select PMSIS_IMPLEM_I2C
endmenu
```

## rtos/pmsis/bsp/flash/Kconfig
```kconfig
menu "FLASH"

    comment "Choose sources to compile"

    config BSP_DRIVER_FLASH
    bool "Flash"
    default n  

    config BSP_DRIVER_FLASH_HYPERFLASH
        bool "HyperFLASH"
        default n  
        select PMSIS_GAP9_IMPLEM_UDMA_HYPERBUS
        select BSP_DRIVER_FLASH

    config BSP_DRIVER_FLASH_MRAM
        bool "MRAM"
        default n
        select BSP_DRIVER_FLASH

    config BSP_DRIVER_FLASH_SPIFLASH
        bool "SPIFLASH"
        default n    
        select BSP_DRIVER_FLASH
        select PMSIS_IMPLEM_SPIM

    config BSP_DRIVER_FLASH_ATXP032
        bool "ATXP032"
        default n
        select BSP_DRIVER_FLASH
        select PMSIS_GAP9_IMPLEM_UDMA_OCTOSPI         

    config BSP_DRIVER_FLASH_MX25U51245
        bool "MX25U51245"
        default n     
        select BSP_DRIVER_FLASH
        select PMSIS_GAP9_IMPLEM_UDMA_OCTOSPI         
endmenu
```

## rtos/pmsis/bsp/fs/Kconfig
```kconfig
menu "File System"

    config BSP_DRIVER_FS_HOSTFS
        bool "HostFS"
        default n

    config BSP_DRIVER_FS_LITTLEFS
        bool "LittleFS"
        default n
        select BSP_DRIVER_PARTITION

    config BSP_DRIVER_FS_READFS
        bool "ReadFS"
        default n
        select BSP_DRIVER_PARTITION
        select BSP_DRIVER_FLASH
endmenu
```

## rtos/pmsis/bsp/gpio/Kconfig
```kconfig
menu "GPIO"

    config BSP_DRIVER_GPIO_FXL6408
        bool "FXL6408"
        default n
        select PMSIS_GAP9_IMPLEM_GPIO
        select PMSIS_IMPLEM_I2C
endmenu
```

## rtos/pmsis/bsp/ota/Kconfig
```kconfig
menu "Over-the-air"

        config BSP_DRIVER_OTA
                bool "OTA"
                default n
                select BSP_DRIVER_PARTITION
                select BSP_DRIVER_FLASH_PARTITION
endmenu
```

## rtos/pmsis/bsp/partition/Kconfig
```kconfig
config BSP_DRIVER_PARTITION
    bool "Partition"
    default n

config BSP_DRIVER_FLASH_PARTITION
    bool "Flash partition"
    default n
    
```

## rtos/pmsis/bsp/ram/Kconfig
```kconfig
menu "RAM"

    config BSP_DRIVER_RAM_HYPERRAM
        bool "HyperRAM"
        default n
        select PMSIS_GAP9_IMPLEM_UDMA_HYPERBUS
    
    config BSP_DRIVER_RAM_SPIRAM_APS25XXXN
        bool "APS25XXXN"
        default n
        select PMSIS_GAP9_IMPLEM_UDMA_OCTOSPI

    config BSP_DRIVER_RAM_SPIRAM
        bool "SPIRAM"
        default n
        select PMSIS_IMPLEM_SPIM
        
endmenu
```

## rtos/pmsis/bsp/transport/Kconfig
```kconfig
menu "Transport"

    config BSP_DRIVER_TRANSPORT_NINA_W10
        bool "Nina W10"
        default n 
        select PMSIS_GAP9_IMPLEM_GPIO
        select PMSIS_IMPLEM_SPIM

    config BSP_DRIVER_TRANSPORT_DA16200
        bool "DA16200"
        default n
        select PMSIS_GAP9_IMPLEM_GPIO
        select PMSIS_IMPLEM_SPIM

    config DEBUG_WIFI_DA16200
        bool "Debug mode"
        default n
        depends on BSP_DRIVER_TRANSPORT_DA16200

endmenu
```

## rtos/pmsis/tests/bsp/ram/simple/Kconfig
```kconfig
menu "Test RAM - Simple"

    config RAM_SIMPLE_REQUIREMENTS
        bool "Examples requirements"
        default y
        select BSP_DRIVER_RAM_SPIRAM_APS25XXXN
        select PMSIS_GAP9_IMPLEM_UDMA_AES
        select BSP_DRIVER_RAM_HYPERRAM
        select PMSIS_GAP9_IMPLEM_QUIDDIKEY
        select BSP_DRIVER_RAM_SPIRAM
        help   
            This example requires modules from the BSP such as : 
                - APS25XXXN driver
                - UDMA AES Driver
                - HYPERRAM Driver
                - QUIDDIKEY Driver
                - SPIRAM
            Disabling this option will make the compilation fail.
endmenu

source "$(GAP_SDK_HOME)/utils/kconfig/Kconfig"
```
